## sdkconfig.defaults
```kconfig
# ESP32-S3-Touch-AMOLED-2.06 specific config
CONFIG_IDF_TARGET="esp32s3"
CONFIG_IDF_TARGET_ESP32S3=y

# Flash
CONFIG_ESPTOOLPY_FLASHSIZE_4MB=y
CONFIG_ESPTOOLPY_FLASHSIZE="4MB"
CONFIG_PARTITION_TABLE_CUSTOM=y
CONFIG_PARTITION_TABLE_CUSTOM_FILENAME="partitions.csv"
CONFIG_PARTITION_TABLE_FILENAME="partitions.csv"

# WiFi
CONFIG_ESP32_WIFI_ENABLED=y
CONFIG_ESP32_WIFI_SCANMETHOD_FAST=y
CONFIG_ESP32_WIFI_TX_PWR_LIMIT=y

# Bluetooth
CONFIG_BT_ENABLED=y
CONFIG_BT_BLE_ENABLED=y

# LVGL
CONFIG_LVGL_TFT_DISPLAY_CONTROLLER_CO5300=y
CONFIG_LVGL_TFT_QSPI=y
CONFIG_LVGL_TFT_DISPLAY_WIDTH=410
CONFIG_LVGL_TFT_DISPLAY_HEIGHT=502

# FreeRTOS
CONFIG_FREERTOS_HZ=1000

# Log
CONFIG_LOG_DEFAULT_LEVEL_INFO=y
CONFIG_LOG_MAXIMUM_LEVEL_VERBOSE=y

# System
CONFIG_ESP_SYSTEM_EVENT_QUEUE_SIZE=32
CONFIG_ESP_SYSTEM_EVENT_TASK_STACK_SIZE=4096
CONFIG_ESP_MAIN_TASK_STACK_SIZE=8192
CONFIG_ESP_TASK_WDT_ENABLED=y
CONFIG_ESP_TASK_WDT_TIMEOUT_S=30

# Allocator
CONFIG_HEAP_POISONING_DISABLED=y
CONFIG_ESP32S3_INSTRUCTION_CACHE_SIZE=32KB
CONFIG_ESP32S3_ICACHE_SIZE=32KB

# yuanfang-brain WS
CONFIG_ESP_WEBSOCKET_URI="ws://192.168.1.10:7103/ws/audio"
CONFIG_XIAOZHI_DEFAULT_WS_URL="ws://192.168.1.10:7104"

# PSRAM (8MB Octal PSRAM on S3R8)
CONFIG_SPIRAM=y
CONFIG_SPIRAM_MODE_OCT=y
CONFIG_SPIRAM_SPEED_80M=y
CONFIG_SPIRAM_TRY_ALLOCATE_WIFI_LWIP=y
CONFIG_SPIRAM_ALLOW_BSS_SEG_EXTERNAL_MEMORY=y
CONFIG_SPIRAM_ALLOW_STACK_EXTERNAL_MEMORY=y
```
